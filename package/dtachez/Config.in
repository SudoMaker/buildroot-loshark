## package/dtachez/Config.in
```kconfig
config BR2_PACKAGE_DTACHEZ
	bool "dtachez"
	depends on BR2_INSTALL_LIBSTDCPP
	help
	  A fork of dtach that uses pipes instead of Unix sockets.

	  https://github.com/SudoMaker/dtachez

comment "dtachez needs a toolchain w/ C++"
	depends on !BR2_INSTALL_LIBSTDCPP
```

## package/jfsutils/Config.in
```kconfig
config BR2_PACKAGE_JFSUTILS
	bool "jfsutils"
	select BR2_PACKAGE_UTIL_LINUX
	select BR2_PACKAGE_UTIL_LINUX_LIBUUID
	help
	  IBM's Journaled File System (JFS) for Linux
	  JFS Utilities
	  Version 1.1.15, March 4, 2011

	  Modified to work with uClibc and GCC 12.
```
